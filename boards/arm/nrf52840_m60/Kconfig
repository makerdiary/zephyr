## boards/arm/nrf52840_m60/Kconfig
```kconfig
# nRF52840-M60 board configuration

# Copyright (c) 2018 makerdiary.com
# SPDX-License-Identifier: Apache-2.0

if BOARD_NRF52840_M60

config BOARD_ENABLE_DCDC
	bool "Enable DCDC mode"
	select SOC_DCDC_NRF52X
	default y

endif # BOARD_NRF52840_M60
```

## boards/arm/nrf52840_m60/Kconfig.board
```kconfig
# nRF52840-M60 board configuration

# Copyright (c) 2018 makerdiary.com
# SPDX-License-Identifier: Apache-2.0

config BOARD_NRF52840_M60
	bool "NRF52840-M60"
	depends on SOC_NRF52840_QIAA
```
